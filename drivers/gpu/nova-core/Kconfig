## drivers/gpu/nova-core/Kconfig
```kconfig
config NOVA_CORE
	tristate "Nova Core GPU driver"
	depends on 64BIT
	depends on PCI
	depends on RUST
	depends on !CPU_BIG_ENDIAN
	select AUXILIARY_BUS
	select RUST_FW_LOADER_ABSTRACTIONS
	default n
	help
	  Choose this if you want to build the Nova Core driver for Nvidia
	  GPUs based on the GPU System Processor (GSP). This is true for Turing
	  and later GPUs.

	  This driver is work in progress and may not be functional.

	  If M is selected, the module will be called nova-core.

choice
	prompt "GSP firmware version"
	depends on NOVA_CORE
	default NOVA_CORE_GSP_FW_580_159_04
	help
	  Select the version of the GSP firmware that Nova Core will
	  request from the GPU and build its bindings against.

config NOVA_CORE_GSP_FW_580_159_04
	bool "580.159.04"

config NOVA_CORE_GSP_FW_570_144
	bool "570.144"

endchoice
```
